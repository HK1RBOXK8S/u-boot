## arch/arm/mach-rockchip/rk3528/Kconfig
```kconfig
if ROCKCHIP_RK3528

config TARGET_RADXA_ROCK_2_RK3528
	bool "Radxa ROCK 2A/2F"
	help
	  Radxa ROCK 2A/2F single board computers with a RK3528A SoC.

config TARGET_HK1RBOXK8S_RK3528
	bool "HK1RBOXK8S"
	help
	  HK1RBOXK8S board with a RK3528 SoC.

config ROCKCHIP_BOOT_MODE_REG
	default 0xff370200

config ROCKCHIP_STIMER_BASE
	default 0xff620000

config SYS_SOC
	default "rk3528"

source "board/radxa/rock-2-rk3528/Kconfig"

source "board/rockchip/hk1rboxk8s-rk3528/Kconfig"

config SYS_CONFIG_NAME
	default "rk3528_common"

endif
```

## board/rockchip/h96max-rk3528/Kconfig
```kconfig
if TARGET_H96MAX_RK3528

config SYS_BOARD
	default "h96max_rk3528"

config SYS_VENDOR
	default "rockchip"

endif
```

## board/rockchip/hk1rboxk8s-rk3528/Kconfig
```kconfig
if TARGET_HK1RBOXK8S_RK3528

config SYS_BOARD
	default "hk1rboxk8s_rk3528"

config SYS_VENDOR
	default "rockchip"

config SYS_CONFIG_NAME
	default "hk1rboxk8s_rk3528"

endif
```
